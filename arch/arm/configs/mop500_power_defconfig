## drivers/rmi4/Kconfig
```kconfig
#
# SEMC RMI4 bus configuration
#

menuconfig SEMC_RMI4_BUS
	bool "SEMC RMI4 bus"
	default n
	help
	  Say yes here if you want to use SEMC version of RMI4 bus.
	  This will enable support for all Synaptics touch chips that
	  use the RMI4 protocol.

	  This option will make all other drivers for this selectble.

	  If unsure, say N

if SEMC_RMI4_BUS

config RMI4_DEBUG_BUS
	bool "RMI4 bus debug messages"
	help
	  Say Y here if you want or need to debug the RMI4 bus. This
	  will enable a lot of debug information which is useful for
	  debugging

	  If unsure, say N here.

config SEMC_GENERIC_RMI4_BUS
	tristate "SEMC rmi4 bus support"
	default y
	help
	  This is required for all RMI4 based devices.
	  Without this you will not have much use of the rest.

	  To compile this driver as a module, choose M here. The
	  module will be called rmi4_bus.

	  If unsure, say M

config SEMC_GENERIC_RMI4_DRIVER
	tristate "SEMC rmi4 platform driver"
	depends on SEMC_GENERIC_RMI4_BUS
	default y
	help
	  This driver is initialized as a platform driver
	  and will (based on supplied platform data) initialize
	  all required RMI4 function drivers.
	  Without this, nothing will work.

	  To compile this driver as a module, choose M here. The
	  module will be called rmi4_driver.

	  If unsure, say Y

config SEMC_GENERIC_RMI4_SPI_ADAPTOR
	tristate "SEMC rmi4 spi adaptor"
	depends on SEMC_GENERIC_RMI4_BUS
	default n
	help
	  This is an RMI4 adaptor that uses the SPI bus. If you have
	  an RMI4 compatible chip on an SPI bus, you will need this.

	  To compile this driver as a module, say M here. The module
	  will be called rmi4_spi_adaptor.

	  If unsure, say N here.

config SEMC_GENERIC_RMI4_I2C_ADAPTOR
	tristate "SEMC rmi4 i2c adaptor"
	depends on SEMC_GENERIC_RMI4_BUS
	default n
	help
	  This is an RMI4 adaptor that uses the I2C bus. If you have
	  an RMI4 compatible chip on an I2C bus, you will need this.

	  To compile this driver as a module, say M here. The module
	  will be called rmi4_i2c_adaptor.

	  If unsure, say N here.

config SEMC_GENERIC_RMI4_F01
	tristate "SEMC rmi4 function 01 handler"
	depends on SEMC_GENERIC_RMI4_BUS
	default y
	help
	  This is a function handler for RMI4 function 01. This function
	  is responsible for interrupt handling and other interesting low
	  level features.
	  Without this, none of the other function handler will work.

	  To compile this driver as a module, choose M here. The module
	  will be called rmi4_function_01.

	  If unsure, say Y here.

config SEMC_GENERIC_RMI4_F11
	tristate "SEMC rmi4 function 11 handler"
	depends on SEMC_GENERIC_RMI4_BUS
	default y
	help
	  This is a function handler for RMI4 function 11. This function
	  is responsible for the 2D area of touch panels.
	  Without this, the touch panel will not work.

	  To compile this driver as a module, choose M here. The module
	  will be called rmi4_function_11.

	  If unsure, say Y here.

config SEMC_GENERIC_RMI4_F34
	tristate "SEMC rmi4 function 34 handler"
	depends on SEMC_GENERIC_RMI4_BUS
	default y
	help
	  This module does firmware upgrade on the chip. If you are going to
	  update chip FW on running devices via for example system SW update,
	  you will want this.

	  To compile this driver as a module, choose M here. The module
	  will be called rmi4_finction_34.

	  If unsure, say Y here.

config SEMC_GENERIC_RMI4_F54
	tristate "SEMC rmi4 function 44 handler"
	depends on SEMC_GENERIC_RMI4_BUS
	default n
	help
	  This module is used for in-hw tuning. This is something that normally
	  is not used.

	  To compile this driver as a module, choose M here. The module
	  will be called rmi4_function_54.

	  If unsure, say N here.

config SEMC_GENERIC_RMI4_F54_DBG_RAW_HEX
	bool "Print data in raw hex"
	depends on SEMC_GENERIC_RMI4_F54
	help
	  Prints read data as raw hex in kernel log.
	  This is mainly used for debugging.

	  This option will enable debug printouts in F54.

	  If unsure, say N here.

config SEMC_GENERIC_RMI4_F54_DBG_HUMAN_READABLE
	bool "Print data human readable"
	depends on SEMC_GENERIC_RMI4_F54
	help
	  Prints read data in human readable form in kernel log.
	  This is mainly of use for debugging.

	  This option will enable some debug functionality in F54.

	  If unsure, say N here.

config SEMC_GENERIC_RMI4_F54_WATCHDOG
	bool "Enable watchdog to reset F54"
	depends on SEMC_GENERIC_RMI4_F54
	help
	  If some call fails, the function can get stuck. This
	  watchdog will reset this function in these cases.

	  This option will enable the wathcdog feature in F54,
	  which wil lensure that it can't get stuck in some
	  arbitrary mode.

	  If unsure, say Y here.

config SEMC_GENERIC_RMI4_CHAR_DEV
	tristate "SEMC rmi4 char_dev handler"
	depends on SEMC_GENERIC_RMI4_BUS
	default n
	help
	  This module is used for in-hw tuning. This is something that normally
	  is not used.

	  To compile this driver as a module, choose M here. The module
	  will be called rmi4_char_dev.

	  If unsure, say N here.

config SEMC_GENERIC_RMI4_3250_EARLY_SUSPEND
	tristate "Enable early suspend for the 3250 chip"
	depends on HAS_EARLYSUSPEND
	default n
	help
	  This module implements early suspend functionality
	  for the 3250 (Incell) touch chip.
	  If you are using one of these chips and are running
	  on Android, you will want to say yes here.

	  To compile this driver as a module, choose M here. The module
	  will be called rmi4_3250_e_suspend

config SEMC_GENERIC_RMI4_3250_EARLY_SUSPEND_DEBUG
	bool "Enable early suspend debug for 3250 chips"
	depends on SEMC_GENERIC_RMI4_3250_EARLY_SUSPEND
	help
	  Enable debug of the early suspend functionslity for
	  the 3250 Incell chips. This will also create sysfs
	  interfaces for modifying the delay before the chip
	  goes into sleep mode.

	  If unure, say N here.

endif # SEMC_RMI4_BUS
```

## drivers/staging/taos/Kconfig
```kconfig
comment "TAOS proximity & light sensor"

config SENSORS_TSL2772
	tristate "TAOS TSL2772 proximity and ambient light sensor"
	depends on I2C
	default n
	help
	 If you say yes here you get support for the TAOS tsl2772,
	 proximity and ambient light sensors.

	 This driver can also be built as a module.  If so, the module
	 will be called tsl2772.
```

## drivers/video/mcde/Kconfig
```kconfig
config MCDE
	bool

config FB_MCDE
	bool "MCDE fbdev support"
	depends on FB
	select FB_SYS_FILLRECT
	select FB_SYS_COPYAREA
	select FB_SYS_IMAGEBLIT
	select FB_SYS_FOPS
	select HWMEM
	select MCDE
	---help---
	  This enables support for MCDE based frame buffer driver.

	  Please read the file <file:Documentation/fb/mcde.txt>

config FB_MCDE_DEBUG
	bool "MCDE debug messages"
	depends on MCDE
	---help---
	  Say Y here if you want the MCDE driver to output debug messages

config FB_MCDE_VDEBUG
	bool "MCDE verbose debug messages"
	depends on FB_MCDE_DEBUG
	---help---
	  Say Y here if you want the MCDE driver to output more debug messages

config MCDE_FB_AVOID_REALLOC
	bool "MCDE early allocate framebuffer"
	default n
	depends on FB_MCDE
	---help---
	  If you say Y here maximum frame buffer size is allocated and
	  used for all resolutions. If you say N here, the frame buffer is
	  reallocated when resolution is changed. This reallocation might
	  fail because of fragmented memory. Note that this memory will
	  never be deallocated, while the MCDE framebuffer is used.

config MCDE_DISPLAY_DSI
	bool "Support for DSI displays within MCDE"
	depends on MCDE
	default y

menu "MCDE DSI displays"
	depends on MCDE_DISPLAY_DSI

config MCDE_DISPLAY_GENERIC_DSI
	tristate "Generic DSI display driver"

config MCDE_DISPLAY_PANEL_DSI
	bool "Display panel driver"

config MCDE_DISPLAY_SAMSUNG_S6D16D0
	bool "Samsung S6D16D0 DSI display driver"
	depends on !MCDE_DISPLAY_PANEL_DSI
	---help---
	  Say Y if you have a TPO Taal or Blackpearl display panel.

config MCDE_DISPLAY_SONY_ACX424AKP_DSI
	tristate "Sony acx424akp DSI display driver"
	depends on !MCDE_DISPLAY_PANEL_DSI

config MCDE_DISPLAY_NT35560_DSI_SONY_ACX424AKM
	bool "Sony ACX424AKM display panel"
	depends on MCDE_DISPLAY_PANEL_DSI

config MCDE_DISPLAY_ROTATE_NT35560_DSI_SONY_ACX424AKM
	bool "Rotate Sony ACX424AKM content 180 degrees"
	depends on MCDE_DISPLAY_NT35560_DSI_SONY_ACX424AKM

config MCDE_DISPLAY_NT35560_DSI_HITACHI_DX09D09VM
	bool "Hitachi DX09D09VM display panel"
	depends on MCDE_DISPLAY_PANEL_DSI

config MCDE_DISPLAY_ROTATE_NT35560_DSI_HITACHI_DX09D09VM
	bool "Rotate Hitachi DX09D09VM content 180 degrees"
	depends on MCDE_DISPLAY_NT35560_DSI_HITACHI_DX09D09VM

config MCDE_DISPLAY_R61408_DSI_SEIKO_RB443
	bool "Seiko RB443 display panel"
	depends on MCDE_DISPLAY_PANEL_DSI

config MCDE_DISPLAY_R61408_DSI_SAMSUNG_LMS347TF01
	bool "Samsung LMS347TF01 display panel"
	depends on MCDE_DISPLAY_PANEL_DSI

config MCDE_DISPLAY_R61529_DSI_SEIKO_RJ248
	bool "Seiko RJ248 display panel"
	depends on MCDE_DISPLAY_PANEL_DSI

config MCDE_DISPLAY_R61529_DSI_HITACHI_TX09D115VM
	bool "Hitachi TX09D115VM display panel"
	depends on MCDE_DISPLAY_PANEL_DSI

config MCDE_DISPLAY_OTM9601_DSI_SONY_ACX438AKM
	bool "Sony ACX438AKM display panel"
	depends on MCDE_DISPLAY_PANEL_DSI

config MCDE_DISPLAY_R61408_DSI_HITACHI_TX09D113
	bool "Hitachi tx09d113 display panel"
	depends on MCDE_DISPLAY_PANEL_DSI

config MCDE_DISPLAY_R61408_DSI_SONY_L5F31178
	bool "Sony l5f31178 display panel"
	depends on MCDE_DISPLAY_PANEL_DSI

config MCDE_DISPLAY_ROTATE_180
	bool "Rotate display content 180 degrees"
	depends on !MCDE_DISPLAY_PANEL_DSI

config MCDE_DISPLAY_AV8100
	tristate "AV8100 HDMI/CVBS display driver"
	select AV8100

config MCDE_DISPLAY_HDMI_FB_AUTO_CREATE
	bool "HDMI_FB_AUTO_CREATE"
	default y
	depends on MCDE_DISPLAY_AV8100
	---help---
	  Say Y if you want the HDMI frame buffer to be created on start
	  Say N if you want the HDMI frame buffer to be created when HDMI
	  cable is plugged (needs user space HDMIservice)

endmenu

config MCDE_DISPLAY_DPI
	bool "Support for DPI displays within MCDE"
	depends on MCDE
	default n
	---help---
	  Add this option to choose which DPI display driver for MCDE to include

	  DPI (Display Pixel Interface) is a MIPI Alliance standard used for
	  active-matrix LCDs. The DPI uses parallel data lines.

menu "MCDE DPI displays"
	depends on MCDE_DISPLAY_DPI

config MCDE_DISPLAY_VUIB500_DPI
	tristate "DPI display driver for the VUIB500 board"
	---help---
	  The VUIB500 is an ST-Ericsson user interface board.

endmenu

config MCDE_DISPLAY_LOGO
	bool "MCDE logo"
	default n
	depends on FB_MCDE
	---help---
	  Say Y here if you want to display the logo.
```
